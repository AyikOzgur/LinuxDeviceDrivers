/dts-v1/;

/ {
    compatible = "brcm,bcm2835";
    fragment@0 {
        target-path = "/";
        __overlay__{
           my_test_device {
             compatible = "my_compatible"; // This is important for platform device driver match
             status = "okay"; // Enable the device tree node
         };  
      };
    };
};