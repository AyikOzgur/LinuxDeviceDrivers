/dts-v1/;
/plugin/;

/ {
    compatible = "brcm,bcm2835";

    fragment@0 {
        target = <&i2c1>;
        __overlay__ {
            /* override the defaults so that reg = <0x50> is legal */
            #address-cells = <1>;
            #size-cells    = <0>;
            status = "okay";
            atc24c@50 {
                compatible = "atmel,at24c";
                reg         = <0x50>;    /* 0xA0 >> 1 */
                status      = "okay";
            };
        };
    };
};
